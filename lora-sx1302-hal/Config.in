## lora-sx1302-hal/Config.in
```kconfig
if PACKAGE_sx1302_hal_wrt

choice
    prompt "LoRaWAN Freq Plan selection"
    default LORA_SX1302_HAL_US915

    config LORA_SX1302_HAL_US915
        bool "US915"
        help
            Select this option for US915 configuration.

    config LORA_SX1302_HAL_EU868
        bool "EU868"
        help
            Select this option for EU868 configuration.

    config LORA_SX1302_HAL_CN490
        bool "CN490"
        help
            Select this option for CN490 configuration.
endchoice

config LORA_SX1302_HAL_GPS
    prompt "Include GPS in SX1302 HAL"
    bool
    depends on PACKAGE_sx1302_hal_wrt
    help
        If you want to include GPS support in the SX1302 HAL package, select this option.


endif
```
